## bak/latest/socsynth/Kconfig
```kconfig
config SND_SOC_OC_I2S
       tristate "OpenCores I2S Controller"
       help
         If you say yes to this option, support will be included for the
         OpenCores I2S controller. For details see

         This driver can also be built as a module.  If so, the module
         will be called opencores_i2s.

config SND_SOC_HSYNTHDMA
       tristate "holosynth DMA Controller"
       help
         If you say yes to this option, support will be included for the
         HSYNTHDMA dma controller. For details see

         This driver can also be built as a module.  If so, the module
         will be called hsynthdma.

config SND_SOC_DE1_WM8731_MIDI
       tristate "DE1-Audio MIDI support"
       select SND_SOC_WM8731
       select SND_SOC_OC_I2S
       select SND_SOC_GENERIC_DMAENGINE_PCM
       select SND_RAWMIDI
       select REGMAP_MMIO
       select SND_SOC_HSYNTH7002
       select SND_SOC_HSYNTHDMA
```

## bak/sound/socsynth/Kconfig
```kconfig
config SND_SOC_OC_I2S
       tristate "OpenCores I2S Controller"
       help
         If you say yes to this option, support will be included for the
         OpenCores I2S controller. For details see

         This driver can also be built as a module.  If so, the module
         will be called opencores_i2s.

config SND_SOC_HSYNTHDMA
       tristate "holosynth DMA Controller"
       help
         If you say yes to this option, support will be included for the
         HSYNTHDMA dma controller. For details see

         This driver can also be built as a module.  If so, the module
         will be called hsynthdma.

config SND_SOC_DE1_WM8731_HSYNTH
       tristate "DE1-Audio MIDI support"
       select SND_SOC_WM8731
       select SND_SOC_OC_I2S
       select SND_SOC_GENERIC_DMAENGINE_PCM
       select REGMAP_MMIO
       select SND_SOC_HSYNTH7002
       select SND_SOC_HSYNTHDMA

config SND_SOC_HSYNTH_MIDI
       tristate "Holosynth MIDI support"

config SND_SOC_PCM5102_HSYNTH
       tristate "DE10-Nano-PiDac/Holosynth audio support"
       select SND_SOC_HSYNTHPCM5102
       select SND_SOC_OC_I2S
       select SND_SOC_GENERIC_DMAENGINE_PCM
       select REGMAP_MMIO
```
