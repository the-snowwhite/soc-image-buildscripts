
	socsound {
		compatible = "holotr,socsynth-audio";
		dmalink-controller = <&dmalink>;
		audio-codec = <&hsynth7002_codec>;
	};

	dmalink: dmalink@40 {
		#sound-dai-cells = <1>;
		compatible = "holotr,dmalink";
		reg = <0xff200040 0x20>, <0xff200060 0x20>;
		clocks = <&clk44>;
		clock-names = "clk44";
		dmas = <&pdma 2>;
		dma-names = "rx";
	};

	hsynth7002_codec: hsynth7002-codec {
   	#sound-dai-cells = <0>;
		compatible = "holotr,hsynth7002";
/*     IOVDD-supply = <&supply>;*/
		status = "okay";
	};
